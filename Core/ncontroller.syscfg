/**
 * @cliArgs --device "MSPM0L130X" --package "VQFN-32(RHB)" --part "Default" --product "mspm0_sdk@2.00.00.03"
 * @versions {"tool":"1.20.0+3587"}
 */

/**
 * Import the modules used in this configuration.
 */
const GPIO   = scripting.addModule("/ti/driverlib/GPIO", {}, false);
const GPIO1  = GPIO.addInstance();
const SYSCTL = scripting.addModule("/ti/driverlib/SYSCTL");

/**
 * Write custom configuration values to the imported modules.
 */
GPIO1.$name                         = "GPIO_LEDS";
GPIO1.port                          = "PORTA";
GPIO1.associatedPins.create(4);
GPIO1.associatedPins[0].assignedPin = "27";
GPIO1.associatedPins[0].$name       = "USER_LED_B";
GPIO1.associatedPins[1].assignedPin = "26";
GPIO1.associatedPins[1].$name       = "USER_LED_R";
GPIO1.associatedPins[2].assignedPin = "13";
GPIO1.associatedPins[2].$name       = "USER_LED_G";
GPIO1.associatedPins[3].$name       = "USER_TEST";
GPIO1.associatedPins[3].pin.$assign = "PA0";

const Board = scripting.addModule("/ti/driverlib/Board", {}, false);

SYSCTL.clockTreeEn = true;

/**
 * Pinmux solution for unlocked pins/peripherals. This ensures that minor changes to the automatic solver in a future
 * version of the tool will not impact the pinmux you originally saw.  These lines can be completely deleted in order to
 * re-solve from scratch.
 */
GPIO1.associatedPins[0].pin.$suggestSolution = "PA27";
GPIO1.associatedPins[1].pin.$suggestSolution = "PA26";
GPIO1.associatedPins[2].pin.$suggestSolution = "PA13";
Board.peripheral.$suggestSolution            = "DEBUGSS";
Board.peripheral.swclkPin.$suggestSolution   = "PA20";
Board.peripheral.swdioPin.$suggestSolution   = "PA19";
